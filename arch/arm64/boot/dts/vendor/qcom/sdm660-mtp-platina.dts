/dts-v1/;

#include "sdm660.dtsi"
#include "sdm660-internal-codec.dtsi"
#include "platina/platina-sdm660.dtsi"
#include "platina/mi-sdm660-common.dtsi"

/ {
	model = "Qualcomm Technologies, Inc. SDM 660 PM660 + PM660L MTP,Int Codec,Platina";
	compatible = "qcom,sdm660-mtp", "qcom,sdm660", "qcom,mtp";
	qcom,board-id = <34 0>;
	qcom,pmic-id = <0x0001001b 0x0101011a 0x0 0x0>,
			<0x0001001b 0x0201011a 0x0 0x0>;
};
